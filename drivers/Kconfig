## drivers/Kconfig
```kconfig
config TINA_USING_UART0
    bool "Using UART0"
    select RT_USING_SERIAL
    default n

config TINA_USING_UART1
    bool "Using UART1"
    select RT_USING_SERIAL
    default y

config TINA_USING_UART2
    bool "Using UART2"
    select RT_USING_SERIAL
    default y

config TINA_USING_SDIO0
    bool "Using SDIO0"
    select RT_USING_SDIO
    default y

config TINA_USING_SPI0
    bool "Using spi0"
    select RT_USING_SPI
    default y

config TINA_USING_SPI1
    bool "Using spi1"
    select RT_USING_SPI
    default y

config TINA_USING_SPI_FLASH
    bool "Using flash"
    select TINA_USING_SPI0
    select RT_USING_SFUD
    default y

config TINA_USING_PWM0
    bool "Using PWM0"
    select RT_USING_PWM
    default y

config TINA_USING_PWM1
    bool "Using PWM1"
    select RT_USING_PWM
    default y

config TINA_USING_I2C0
    bool "Using I2C0"
    select RT_USING_I2C
    default y

config TINA_USING_I2C1
    bool "Using I2C1"
    select RT_USING_I2C
    default y

config TINA_USING_I2C2
    bool "Using I2C2"
    select RT_USING_I2C
    default y

config TINA_USING_TP_ADC
    bool "Using TP ADC"
    select RT_USING_ADC
    default y

config TINA_USING_KEY_ADC
    bool "Using KEY ADC"
    select RT_USING_ADC
    default y
```
